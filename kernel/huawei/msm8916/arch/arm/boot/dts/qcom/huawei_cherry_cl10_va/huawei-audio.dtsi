/ {
    huawei_audio_info {
        compatible = "huawei,hw_audio_info";
        product-identifier = "cherry";
        builtin-master-mic-exist;
        builtin-2nd-mic-exist;
        hand_held_dual_mic_strategy;
        status = "ok";
        aud_param_ver = "che1_cl10_audio_A04";
        loud_speaker_second_mic_strategy;
        product-btsco-nrec-adapt;
    };
};
&soc {
    sound {
        qcom,msm-micbias1-ext-cap;
    };
};
